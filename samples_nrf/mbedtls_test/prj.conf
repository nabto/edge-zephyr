## CMakeLists.txt
```
cmake_minimum_required(VERSION 3.20.0)
find_package(Zephyr REQUIRED HINTS $ENV{ZEPHYR_BASE})

project(mbedtls_test LANGUAGES C VERSION 1.0.0)

zephyr_system_include_directories(${CMAKE_CURRENT_SOURCE_DIR}/src)
#zephyr_library_compile_definitions(-DMBEDTLS_SSL_ALPN)

target_sources(app PRIVATE src/main.c)



#zephyr_include_directories(${APPLICATION_SOURCE_DIR}/src/tls_config)
#zephyr_include_directories(${CMAKE_CURRENT_SOURCE_DIR}/src/tls_config)
#zephyr_link_libraries(mbedTLS)
#zephyr_library_compile_definitions(-DNABTO_DEVICE_NO_FUTURE_QUEUE)
#zephyr_library_compile_definitions(-DNP_CONFIG_FILE=<np_config_zephyr.h>)
#set(CMAKE_CXX_FLAGS "-03")
```

## prj.conf
```kconfig
CONFIG_SHELL=y
CONFIG_LOG=y

CONFIG_MBEDTLS_LIBRARY_NRF_SECURITY=y
CONFIG_MBEDTLS_TLS_LIBRARY=y
CONFIG_MBEDTLS_TLS_VERSION_1_2=y
CONFIG_MBEDTLS_DTLS=y
CONFIG_MBEDTLS_SSL_PROTO_DTLS=y
CONFIG_MBEDTLS_SSL_SERVER_NAME_INDICATION=y
CONFIG_MBEDTLS_CCM_C=y
CONFIG_MBEDTLS_ECP_C=y
CONFIG_MBEDTLS_PSA_CRYPTO_C=y
CONFIG_MBEDTLS_CTR_DRBG_ENABLED=y
#CONFIG_MBEDTLS_SSL_ALPN=y

#CONFIG_GENERATE_MBEDTLS_CFG_FILE=n
#CONFIG_MBEDTLS_CFG_FILE="mbedtls-test-nrf-config.h"
CONFIG_MBEDTLS_USER_CONFIG_FILE="mbedtls-test-config-nabto.h"
```

## src/main.c
```c
#include <zephyr/logging/log.h>

#include <mbedtls/ssl.h>
#include <mbedtls/check_config.h>
#include <mbedtls/ctr_drbg.h>

LOG_MODULE_REGISTER(main, LOG_LEVEL_DBG);

int main()
{
    // see that some apis work
    mbedtls_ssl_config config;
    mbedtls_ssl_config_init(&config);
    const char *alpnList[2] = {"foo", NULL};
    // se that alpn does not work
    mbedtls_ssl_conf_alpn_protocols(NULL, alpnList);

    mbedtls_ctr_drbg_context ctr_drbg;
    mbedtls_ctr_drbg_init( &ctr_drbg );

    LOG_INF("int main().\n");
    return 0;
}
```

## src/config-nabto.h
```c
#define MBEDTLS_SSL_ALPN 1
```

## src/mbedtls-test-config-nabto.h
```c
#define MBEDTLS_SSL_ALPN 1
#define MBEDTLS_CTR_DRBG_C
```
