## CMakeLists.txt
```
cmake_minimum_required(VERSION 3.13.1)
find_package(Zephyr REQUIRED HINTS $ENV{ZEPHYR_BASE})

project(app LANGUAGES C VERSION 1.0.0)

#zephyr_system_include_directories(${CMAKE_CURRENT_SOURCE_DIR}/src/tls_config)
#zephyr_include_directories(${CMAKE_CURRENT_SOURCE_DIR}/src/tls_config)


target_sources(app PRIVATE src/main.c src/modem.c src/cloud.c)
```

## Kconfig
```
mainmenu "Nabto Edge Simple Coap Demo"

config SIMPLE_COAP_PRODUCT_ID
	string "nabto product id"
	default "pr-123"
	help
	  The nabto product id to use

config SIMPLE_COAP_DEVICE_ID
	string "nabto device id"
	default "de-123"
	help
	  The nabto device id to use

config SIMPLE_COAP_PRIVATE_KEY
    string "nabto device key"
	default ""
	help
	  The nabto device key as a hex encoded 256bit random number

source "Kconfig.zephyr"
```

## prj.conf
```kconfig
CONFIG_NEWLIB_LIBC=y
# CONFIG_NEWLIB_LIBC_NANO=n

## Below is nabto config
CONFIG_NABTO_EMBEDDED_SDK=y

#CONFIG_NRF_SECURITY_RNG=y
CONFIG_MBEDTLS_ENABLE_HEAP=y
CONFIG_MBEDTLS_HEAP_SIZE=60240
#
#
CONFIG_INIT_STACKS=y
CONFIG_NET_LOG=y
CONFIG_LOG=y
CONFIG_SHELL=y

## Mbedtls Config
CONFIG_MBEDTLS_LIBRARY_NRF_SECURITY=y
CONFIG_MBEDTLS_CCM_C=y
CONFIG_MBEDTLS_TLS_LIBRARY=y
CONFIG_MBEDTLS_ECP_DP_SECP256R1_ENABLED=y
CONFIG_MBEDTLS_ECP_C=y
CONFIG_MBEDTLS_ECDSA_C=y
CONFIG_MBEDTLS_PK_C=y
CONFIG_MBEDTLS_PK_WRITE_C=y
CONFIG_MBEDTLS_AES_C=y
CONFIG_MBEDTLS_CTR_DRBG_C=y
CONFIG_MBEDTLS_ENTROPY_C=y
CONFIG_MBEDTLS_PSA_CRYPTO_C=y
CONFIG_MBEDTLS_X509_REMOVE_INFO=n
CONFIG_MBEDTLS_HMAC_DRBG_C=y
CONFIG_MBEDTLS_USER_CONFIG_FILE="config-nabto.h"
#CONFIG_MBEDTLS_CFG_FILE="app-nrf-config.h"
CONFIG_PSA_WANT_ALG_CCM=y
CONFIG_PSA_WANT_ALG_CTR_DRBG=y
CONFIG_PSA_WANT_ALG_HMAC_DRBG=y
CONFIG_PSA_WANT_GENERATE_RANDOM=y
CONFIG_MBEDTLS_KEY_EXCHANGE_ECDHE_ECDSA_ENABLED=y
CONFIG_PSA_CRYPTO_DRIVER_CC3XX=y
CONFIG_MBEDTLS_SSL_OUT_CONTENT_LEN=2048
CONFIG_MBEDTLS_SSL_IN_CONTENT_LEN=2048


CONFIG_MAIN_STACK_SIZE=10240
CONFIG_SYSTEM_WORKQUEUE_STACK_SIZE=10240
CONFIG_ISR_STACK_SIZE=10240
CONFIG_HEAP_MEM_POOL_SIZE=65536
CONFIG_NET_RX_STACK_SIZE=8192
CONFIG_SHELL_STACK_SIZE=8192
#CONFIG_NET_MGMT_EVENT_STACK_SIZE=8192
CONFIG_NET_TX_STACK_SIZE=8192
#CONFIG_NET_TCP_WORKQ_STACK_SIZE=8192
CONFIG_IDLE_STACK_SIZE=8192
#
CONFIG_THREAD_STACK_INFO=y
CONFIG_THREAD_MONITOR=y
CONFIG_KERNEL_SHELL=y
CONFIG_INIT_STACKS=y
CONFIG_THREAD_NAME=y
CONFIG_STACK_SENTINEL=y
CONFIG_DEBUG_THREAD_INFO=y
CONFIG_LOG_MODE_IMMEDIATE=y
CONFIG_ASSERT=y
##
CONFIG_FLASH=y
CONFIG_FLASH_PAGE_LAYOUT=y
CONFIG_FLASH_MAP=y

CONFIG_SETTINGS=y
CONFIG_SETTINGS_RUNTIME=y
CONFIG_SETTINGS_DYNAMIC_HANDLERS=y
CONFIG_SETTINGS_SHELL=y
CONFIG_MPU_ALLOW_FLASH_WRITE=y
##
#CONFIG_REBOOT=y
##
##
##### Local config

#CONFIG_SIMPLE_COAP_PRODUCT_ID="pr-x4dq7mqh"
#CONFIG_SIMPLE_COAP_DEVICE_ID="de-pgjgb9ki"
#CONFIG_SIMPLE_COAP_PRIVATE_KEY="0c4faf750ce9264eb8bd8020777487f581443d30c7d3279f8244b3060e340f5e"

CONFIG_SIMPLE_COAP_PRODUCT_ID="pr-9fbbczma"
CONFIG_SIMPLE_COAP_DEVICE_ID="de-ncozrk3s"
CONFIG_SIMPLE_COAP_PRIVATE_KEY="1d8997f266bae21dc56be42cf669b932952d9576bbb12bbae2d34a2c0be60391"

#
#
## Generic networking options
#
## Socket
#
#
## CoAP
#CONFIG_COAP=y
#CONFIG_COAP_WELL_KNOWN_BLOCK_WISE=n
#
## Kernel options
#
## Logging
CONFIG_PRINTK=y
CONFIG_NET_LOG=y
#
## Network Shell
# CONFIG_NET_SHELL=y
#
#

#
## Configuration
# CONFIG_NET_CONFIG_SETTINGS=y

# Enable only one protocol, if you enable both sources
# won't compile.
# IPv6 Support
# CONFIG_NET_IPV6=y
# CONFIG_NET_CONFIG_NEED_IPV6=y
# CONFIG_NET_CONFIG_NEED_IPV4=y
# CONFIG_NET_CONFIG_MY_IPV6_ADDR="2001:db8::1"
# CONFIG_NET_IF_MCAST_IPV6_ADDR_COUNT=5
# CONFIG_NET_DHCPV4=y


#CONFIG_DNS_RESOLVER=y
#CONFIG_DNS_SERVER_IP_ADDRESSES=y
#CONFIG_DNS_SERVER1="8.8.8.8"
#CONFIG_DNS_RESOLVER_LOG_LEVEL_DBG=y

# CONFIG_NET_UDP=y
# CONFIG_NET_TCP=y
#CONFIG_NET_IPV4=y
#CONFIG_NET_IPV6=y
# CONFIG_NET_ARP=y
# CONFIG_NET_STATISTICS=y
# CONFIG_NET_SOCKETS=y
# CONFIG_NET_SOCKETS_POSIX_NAMES=y
# CONFIG_NET_SOCKETPAIR=y
# CONFIG_NET_SOCKETS_POLL_MAX=42
# CONFIG_NET_NATIVE=y
#CONFIG_DNS_RESOLVER=y
# CONFIG_NET_MAX_CONTEXTS=16
# CONFIG_NET_MAX_CONN=16
###
#CONFIG_POSIX_MAX_FDS=16


# Network
#CONFIG_NETWORKING=y
#CONFIG_NET_NATIVE=n
#CONFIG_NET_SOCKETS=y
#CONFIG_NET_SOCKETS_OFFLOAD=y
#CONFIG_NET_SOCKETS_POLL_MAX=10
#CONFIG_NET_SOCKETS_POSIX_NAMES=n

# LTE link control
CONFIG_LTE_LINK_CONTROL=y

# Modem library
CONFIG_NRF_MODEM_LIB=y

# LTE parameters
## PSM
# CONFIG_UDP_PSM_ENABLE=y
# CONFIG_LTE_PSM_REQ_RPTAU="00100001"
# CONFIG_LTE_PSM_REQ_RAT="00000000"

## eDRX
# CONFIG_UDP_EDRX_ENABLE=n

## RAI
# CONFIG_UDP_RAI_ENABLE=y



# Enable net shell commands
# CONFIG_NET_SHELL=y
# CONFIG_NET_STATISTICS_USER_API=y

# Enable needed stuff from native net stack
CONFIG_NETWORKING=y
CONFIG_NET_NATIVE=n
CONFIG_NET_STATISTICS=y
CONFIG_NET_STATISTICS_IPV4=n
#CONFIG_NET_L2_DUMMY=y

CONFIG_NET_LOG=y
CONFIG_NET_CONFIG_AUTO_INIT=y

CONFIG_NET_SOCKETS=y
CONFIG_NET_SOCKETS_OFFLOAD=y

CONFIG_NET_IF_MAX_IPV4_COUNT=1
#CONFIG_NET_IF_MAX_IPV6_COUNT=1

CONFIG_NET_IPV4=y
#CONFIG_NET_IPV6=y
CONFIG_NET_TCP=y
CONFIG_NET_UDP=y

# Disable certain parts of Zephyr IPv6 stack
#CONFIG_NET_IPV6_NBR_CACHE=n
#CONFIG_NET_IPV6_MLD=n
#CONFIG_NET_IPV6_FRAGMENT=n

#Following selects MBEDTLS_MAC_MD5_ENABLED that needs bunch of other features
CONFIG_NET_TCP_ISN_RFC6528=n

#Default RTO is too short and causes spurious retransmissions in uplink
CONFIG_NET_TCP_INIT_RETRANSMISSION_TIMEOUT=1500
CONFIG_NET_TCP_RETRY_COUNT=6

# Enable the DNS resolver:
# as a default the ones from LTE default context are used
#CONFIG_DNS_RESOLVER=y

#CONFIG_DNS_SERVER_IP_ADDRESSES=y
#CONFIG_DNS_SERVER1="8.8.8.8"

CONFIG_NET_IP_ADDR_CHECK=n
CONFIG_NET_DRIVERS=y

# Uncomment to get maximum throughput.
#CONFIG_NRF_MODEM_LIB_SHMEM_TX_SIZE=32768
#CONFIG_NRF_MODEM_LIB_SHMEM_RX_SIZE=16384

# Network buffers
#CONFIG_NET_BUF=y
#CONFIG_NET_BUF_DATA_SIZE=128
#CONFIG_NET_BUF_POOL_USAGE=y

#CONFIG_NET_PKT_RX_COUNT=20
#CONFIG_NET_BUF_RX_COUNT=30

#CONFIG_NET_PKT_TX_COUNT=100
#CONFIG_NET_BUF_TX_COUNT=100

#CONFIG_NET_TC_RX_COUNT=0

# Debug options
CONFIG_NET_CORE_LOG_LEVEL_WRN=y
CONFIG_NET_IF_LOG_LEVEL_WRN=y
CONFIG_NET_TCP_LOG_LEVEL_WRN=y

CONFIG_NET_PKT_LOG_LEVEL_WRN=y
CONFIG_NET_DEBUG_NET_PKT_ALLOC=y

CONFIG_NET_CONTEXT_LOG_LEVEL_WRN=y
CONFIG_UART_CONSOLE_LOG_LEVEL_WRN=y

CONFIG_NET_BUF_LOG_LEVEL_OFF=y

CONFIG_NET_CONN_LOG_LEVEL_WRN=y
CONFIG_NET_BUF_WARN_ALLOC_INTERVAL=0

# Nabto additions
CONFIG_NET_SOCKETPAIR=y
CONFIG_NET_SOCKETS_POLL_MAX=16
CONFIG_POSIX_MAX_FDS=16


CONFIG_DEBUG_OPTIMIZATIONS=y
CONFIG_DEBUG_THREAD_INFO=y
CONFIG_HW_STACK_PROTECTION=y

CONFIG_NEWLIB_LIBC=y
CONFIG_CBPRINTF_FP_SUPPORT=y


CONFIG_NABTO_LOG_LEVEL_DBG=y
```

## boards/nrf9160dk_nrf9160_ns.conf
```kconfig
#CONFIG_GENERATE_MBEDTLS_CFG_FILE=n
#CONFIG_APP_MBEDTLS_CFG_FILE="nrf-config-nabto.h"
#CONFIG_APP_MBEDTLS_USER_CONFIG_FILE="config-nabto.h"
```

## src/main.c
```c
/* main.c - Copyright Svep Design Center AB */

/**** Includes ****/
#include <stdint.h>
#include <stdio.h>
#include <errno.h>
#include "mbedtls/entropy.h"
#include <zephyr/kernel.h>
#include <zephyr/logging/log.h>
#include <zephyr/net/sntp.h>
#include <date_time.h>
#include <pthread.h>
#include "modem.h"
#include "cloud.h"
/**** Defines ****/
LOG_MODULE_REGISTER(main, LOG_LEVEL_DBG);
#define MY_STACK_SIZE 8192
#define MY_PRIORITY 1
K_THREAD_STACK_DEFINE(my_stack_area, MY_STACK_SIZE);


/**** Types ****/


/**** Data ****/
static int64_t m_curr_time_ms = 0;
static int m_lte_connected = 0;
static struct k_thread cloud_thread;


/**** Private functions ****/
static void date_time_evt_handeler(const struct date_time_evt *evt)
{
    if (evt == NULL) {
        printf("Error: Event pointer is NULL\n");
        return;
    }
    int err;
    switch (evt->type) {
        case DATE_TIME_OBTAINED_MODEM:
            LOG_INF("Date and time obtained from modem.\n");
            break;
        case DATE_TIME_OBTAINED_NTP:
            LOG_INF("Date and time obtained from NTP servers.\n");
            err = date_time_now(&m_curr_time_ms);
            if (err != 0 || !date_time_is_valid()) {
                LOG_WRN("Counld not get current tine. Error: %d \n", err);
            } else if (err == 0) {
                LOG_INF("Current time: %lld \n", m_curr_time_ms);
            }
            break;
        case DATE_TIME_OBTAINED_EXT:
            LOG_INF("Date and time obtained from external source.\n");
            break;
        case DATE_TIME_NOT_OBTAINED:
            LOG_INF("Date and time not obtained.\n");
            break;
        default:
            LOG_INF("Unknown date_time event type.\n");
            break;
    }
}

static void time_get()
{
    struct sntp_time current_time;

    /* Server address */
    const char *server_addr = "sth1.ntp.se";

    /* Timeout for SNTP query (in milliseconds) */
    uint32_t timeout = 5000;

    /* Perform SNTP query */
    int ret = sntp_simple(server_addr, timeout, &current_time);

    if (ret < 0) {
        LOG_WRN("SNTP query failed: %d\n", ret);
    } else {
        /* Convert SNTP time to standard UNIX time */
        time_t unix_time = (time_t)(current_time.seconds);

        /* Convert fractional seconds to milliseconds */
        uint32_t milliseconds = (uint32_t)((float)current_time.fraction * 1.0e3 / (float)(1LL << 32));
        LOG_INF("milliseconds %d \n", milliseconds);
        LOG_INF("frac: %d\n", (uint32_t)current_time.fraction);
        LOG_INF("Current time: %s.%03u\n", ctime(&unix_time), milliseconds);
    }

}

static void modem_callback(modem_event_t event, uint32_t payload)
{
    switch (event)
    {
        case MODEM_EVENT_CONNECTING:
            LOG_INF("Connecting! \n");
            break;
        case MODEM_EVENT_CONNECTED:
            //m_app_event = APP_EVENT_CONNECTED;
            if (m_lte_connected)
            {
                break;
            }
            m_lte_connected = 1;
            LOG_INF("Connected!\n");
            //int err = date_time_update_async(date_time_evt_handeler);
            //if (err == 0)
            //{
            //    LOG_INF("Date Time is enabled\n");
            //    date_time_register_handler(date_time_evt_handeler);
            //}
            //else
            //{
            //    LOG_INF("Could not get time, err: %d \n", err);
            //}
            //time_get();
            //cloud_init(); // Initialize the cloud
            break;
        default:
            printk("Unknow event");
            break;
    }
}

void start_cloud_thread(void *arg, void* arg2, void* arg3) {


    cloud_init();

    return;
}

/**** Public functions ****/
int main()
{
    int ret = modem_init(modem_callback);
    if (ret == 0)
    {
        //k_sleep(K_MSEC(10000));
        ret = modem_connect();
    }
    else
    {
        LOG_INF("Modem could not be initialized");
    }

    if (ret == 0)
    {
        LOG_INF("Modem connects \n");
    }
    else
    {
        LOG_INF("Modem could not conenct, err: %d \n", ret);
    }

    k_sleep(K_MSEC(5000));
    LOG_INF("Testing Cloud! \n");

    k_tid_t my_tid = k_thread_create(&cloud_thread, my_stack_area,
                                     K_THREAD_STACK_SIZEOF(my_stack_area),
                                     start_cloud_thread,
                                     NULL, NULL, NULL,
                                     MY_PRIORITY, 0, K_NO_WAIT);

    printk("Thread created\n");

    return 0;
}


int mbedtls_hardware_poll(void *data, unsigned char *output, size_t len, size_t *olen) {
    for (size_t i = 0; i < len; i++) {
        output[i] = 0;
    }
    *olen = len;
    return 0;
}
```

## src/cloud.c
```c
/* cloud.c - Copyright Svep Design Center AB */

/**** Includes ****/
#include <stdint.h>
#include <stdio.h>

#include <zephyr/kernel.h>
#include <zephyr/logging/log.h>
#include <zephyr/net/dns_resolve.h>
#include <date_time.h>

#include <zephyr/net/net_if.h>
#include <zephyr/settings/settings.h>

#include <nabto/nabto_device_test.h>
#include <nabto/nabto_device_experimental.h>
#include <nabto/nabto_device_zephyr.h>
#include "cloud.h"

/**** Defines ****/
LOG_MODULE_REGISTER(cloud, LOG_LEVEL_DBG);

#define STORAGE_PARTITION	storage_partition
#define STORAGE_PARTITION_ID	FIXED_PARTITION_ID(STORAGE_PARTITION)

#define ASSERT_NABTO_EC(ec)                                                \
    do                                                                     \
    {                                                                      \
        if (ec != NABTO_DEVICE_EC_OK)                                      \
        {                                                                  \
            LOG_ERR("Call failed %s", nabto_device_error_get_message(ec)); \
            k_sleep(K_FOREVER);                                            \
        }                                                                  \
    } while (false)

// _ASSERT(ec == NABTO_DEVICE_EC_OK, "Call failed %s", nabto_device_error_get_message(ec))

/**** Types ****/


/**** Data ****/
static const char* coapPath[] = { "hello-world", NULL };
static const char* helloWorld = "Hello World from zephyr";

/**** Private functions ****/
static void init_fs()
{
#if IS_ENABLED(CONFIG_SETTINGS_FS)
    int rc;
    FS_LITTLEFS_DECLARE_DEFAULT_CONFIG(cstorage);

    /* mounting info */
    static struct fs_mount_t littlefs_mnt = {
        .type = FS_LITTLEFS,
        .fs_data = &cstorage,
        .storage_dev = (void *)STORAGE_PARTITION_ID,
        .mnt_point = "/ff"};

    rc = fs_mount(&littlefs_mnt);
    if (rc != 0)
    {
        printk("mounting littlefs error: [%d]\n", rc);
    }
    else
    {

        rc = fs_unlink(CONFIG_SETTINGS_FS_FILE);
        if ((rc != 0) && (rc != -ENOENT))
        {
            printk("can't delete config file%d\n", rc);
        }
        else
        {
            printk("FS initialized: OK\n");
        }
    }
#endif
}

/**** Public functions ****/
int cloud_init()
{


    init_fs();
    int status;
    status = settings_subsys_init();
    if (status != 0)
    {
        LOG_ERR("Cannot init settings %s", strerror(-status));
        return status;
   }
   status = settings_load();
   __ASSERT(status == 0, "cannot load settings");
    struct net_if *iface;
    iface = net_if_get_default();

    if (iface==NULL)
    {
        LOG_ERR("iface is null");
    }
    else
    {
        LOG_INF("iface is not null");
    }

#if CONFIG_NET_DHCPV4
    net_dhcpv4_start(iface);
#endif

    NabtoDeviceError ec;

    //return 0;

    NabtoDevice* device = nabto_device_zephyr_get_default_instance();

    __ASSERT(device != NULL, "Device is NULL");
    nabto_device_set_log_level(NULL, "trace");

    ec = nabto_device_set_product_id(device, CONFIG_SIMPLE_COAP_PRODUCT_ID);
    ASSERT_NABTO_EC(ec);

    ec = nabto_device_set_device_id(device, CONFIG_SIMPLE_COAP_DEVICE_ID);
    ASSERT_NABTO_EC(ec);

    uint8_t key[32];
    __ASSERT(strlen(CONFIG_SIMPLE_COAP_PRIVATE_KEY) == 64, "CONFIG_SIMPLE_COAP_PRIVATE_KEY should be 64 hex characters");
    size_t convertedLength = hex2bin(CONFIG_SIMPLE_COAP_PRIVATE_KEY, strlen(CONFIG_SIMPLE_COAP_PRIVATE_KEY), key, sizeof(key));
    __ASSERT(convertedLength == sizeof(key), "Could  not parse the hex string CONFIG_SIMPLE_COAP_PRIVATE_KEY");
    ec = nabto_device_set_private_key_secp256r1(device, key, sizeof(key));
    //ec = nabto_device_enable_mdns(device);
    ASSERT_NABTO_EC(ec);
    ec = nabto_device_add_server_connect_token(device, "demosct");
    ASSERT_NABTO_EC(ec);

    NabtoDeviceFuture* future = nabto_device_future_new(device);
    nabto_device_start(device, future);
    ec = nabto_device_future_wait(future);
    ASSERT_NABTO_EC(ec);

    //char* fp = NULL;
    //ec = nabto_device_get_device_fingerprint(device, &fp);
    //ASSERT_NABTO_EC(ec);

    LOG_INF("Nabto device started w/o fingerprint, do we have that? \n");
    //nabto_device_string_free(fp);

    NabtoDeviceListener* listener = nabto_device_listener_new(device);
    __ASSERT(listener != NULL, "Listener is NULL");

    ec = nabto_device_coap_init_listener(device, listener, NABTO_DEVICE_COAP_GET, coapPath);
    ASSERT_NABTO_EC(ec);


    while(true)
    {
        NabtoDeviceCoapRequest* coapRequest;
        nabto_device_listener_new_coap_request(listener, future, &coapRequest);
        LOG_INF("Listener_new_coap_request: %d \n", ec);
        ec = nabto_device_future_wait(future);
        LOG_INF("Future wait: %d \n", ec);

        LOG_INF("check status: %d \n", ec);

        if (ec != NABTO_DEVICE_EC_OK) {
            LOG_INF("error code: %d \n", ec);
            break;
        } else
        {
            nabto_device_coap_response_set_code(coapRequest, 205);
            LOG_INF("Set code: %d \n", ec);

            nabto_device_coap_response_set_content_format(coapRequest, NABTO_DEVICE_COAP_CONTENT_FORMAT_TEXT_PLAIN_UTF8);
            LOG_INF("Set content: %d \n", ec);

            if (nabto_device_coap_response_set_payload(coapRequest, helloWorld, strlen(helloWorld)) == NABTO_DEVICE_EC_OK)
            {
                LOG_INF("Set payload: %d \n", ec);

                nabto_device_coap_response_ready(coapRequest);
            }
            LOG_INF("Responded to CoAP request\n");
            nabto_device_coap_request_free(coapRequest);
        }
    }

    nabto_device_listener_free(listener);
    nabto_device_future_free(future);
    return 0;
}
```

## src/cloud.h
```c
#ifndef CLOUD_H__
#define CLOUD_H__

/* modem.h - Copyright Svep Design Center AB */


/**** Includes ****/
#include <stdint.h>

/**** Defines ****/
typedef enum {
    CLOUD_EVENT_GOT_MESSAGE,
    CLOUD_EVENT_CONNECTING,
    CLOUD_EVENT_CONNECTED,
    CLOUD_EVENT_PUBLISHED,
} cloud_event_t;

/**** Types ****/
typedef void (*cloud_event_cb_t)(cloud_event_t event);


/**** Data ****/


/**** Public functions ****/
int cloud_init();

#endif
```

## src/modem.c
```c
/* modem.c - Copyright Svep Design Center AB */

/**
 * @file modem.c
 *
 * This module handles the modem. It initializes the modem and connects to the LTE network.
*/

/**** Includes ****/
#include "modem.h"

#include <stdio.h>
#include <stdbool.h>

#include <zephyr/logging/log.h>
#include <zephyr/kernel.h>
#include <modem/lte_lc.h>
#include <modem/nrf_modem_lib.h>
#include <modem/modem_info.h>
#include <modem/modem_key_mgmt.h>
//#include <net/nrf_cloud.h>


/**** Defines ****/


/**** Types ****/


/**** Data ****/
LOG_MODULE_REGISTER(modem, LOG_LEVEL_DBG);

//static int modem_lib_init_result = -1;
static modem_event_cb_t m_cb;
K_SEM_DEFINE(lte_connected, 0, 1);

/**** Private functions ****/
static void lte_handler(const struct lte_lc_evt *const evt)
{
    LOG_INF("Callback : %d \n", evt->type);

    switch (evt->type) {
    case LTE_LC_EVT_NW_REG_STATUS:
        if ((evt->nw_reg_status != LTE_LC_NW_REG_REGISTERED_HOME) &&
             (evt->nw_reg_status != LTE_LC_NW_REG_REGISTERED_ROAMING)) {
            break;
        }

        LOG_DBG("Network registration status: %s\n",
            evt->nw_reg_status == LTE_LC_NW_REG_REGISTERED_HOME ?
            "Connected - home network" : "Connected - roaming");

        //m_cb(MODEM_EVENT_CONNECTED, 0);

        break;

    case LTE_LC_EVT_PSM_UPDATE:
        LOG_DBG("PSM parameter update: TAU: %d, Active time: %d\n",
            evt->psm_cfg.tau, evt->psm_cfg.active_time);
        break;

    case LTE_LC_EVT_EDRX_UPDATE: {
        char log_buf[60];
        int len;

        len = snprintf(log_buf, sizeof(log_buf),
                   "eDRX parameter update: eDRX: %f, PTW: %f",
                   evt->edrx_cfg.edrx, evt->edrx_cfg.ptw);
        if (len > 0) {
            LOG_DBG("%s\n", log_buf);
        }
        break;
    }

    case LTE_LC_EVT_RRC_UPDATE:
        LOG_DBG("RRC mode: %s\n",
            evt->rrc_mode == LTE_LC_RRC_MODE_CONNECTED ?
            "Connected" : "Idle");
        //m_cb(MODEM_EVENT_CONNECTED, 1);
        break;

    case LTE_LC_EVT_CELL_UPDATE:


        LOG_DBG("LTE cell changed: Cell ID: %d, Tracking area: %d\n",
            evt->cell.id, evt->cell.tac);
        break;

    default:
        break;
    }
}


/**** Public functions ****/
/**
 * @brief Initializes the modem module.
 *
 * @param[in] cb The callback function to call when a modem event occurs.
 *
 * @return int Zero on success or (negative) error code otherwise.
*/
int modem_init(modem_event_cb_t cb)
{
    m_cb = cb;
    LOG_INF("Initializing modem library");

	int ret = nrf_modem_lib_init();

	/* Handle return values relating to modem firmware update */

	switch (ret) {
	case 0:
		/* Initialization successful, no action required. */
        LOG_INF("Modem library initialized");
		return 0;
	//case NRF_MODEM_LIB_H:
	//	LOG_DBG("MODEM UPDATE OK. Will run new modem firmware after reboot");
	//	break;
	case NRF_MODEM_DFU_RESULT_UUID_ERROR:
	case NRF_MODEM_DFU_RESULT_AUTH_ERROR:
		LOG_ERR("MODEM UPDATE ERROR %d. Will run old firmware", ret);
		break;
	case NRF_MODEM_DFU_RESULT_HARDWARE_ERROR:
	case NRF_MODEM_DFU_RESULT_INTERNAL_ERROR:
		LOG_ERR("MODEM UPDATE FATAL ERROR %d. Modem failure", ret);
		break;
	//case MODEM_DFU_RESULT_VOLTAGE_LOW:
	//	LOG_ERR("MODEM UPDATE CANCELLED %d.", ret);
	//	LOG_ERR("Please reboot once you have sufficient power for the DFU");
	//	break;
	default:
		/* All non-zero return codes other than DFU result codes are
		 * considered irrecoverable and a reboot is needed.
		 */
		LOG_ERR("nRF modem lib initialization failed, error: %d", ret);
		break;
	}

    ret = lte_lc_init();
// prepeare for fota
//#if defined(CONFIG_NRF_CLOUD_FOTA)
//	/* Ignore return value, rebooting below */
//	(void)nrf_cloud_fota_pending_job_validate(NULL);
//#endif
//	LOG_DBG("Rebooting...");
//	LOG_PANIC();
//	sys_reboot(SYS_REBOOT_COLD);
    return ret;
}


/**
 * @brief Connects to the LTE network.
 *
 * @return int Zero on success or (negative) error code otherwise.
*/
int modem_connect(void)
{
    int err;

	if (IS_ENABLED(CONFIG_LTE_AUTO_INIT_AND_CONNECT)) {
		/* Do nothing, modem is already configured and LTE connected. */

	} else {
		err = lte_lc_init_and_connect_async(lte_handler);;
		if (err) {
			LOG_ERR("Modem could not be configured, error: %d\n",
				err);
			return err;
		}
	}

    m_cb(MODEM_EVENT_CONNECTING, 0);

    return 0;
}
```

## src/modem.h
```c
#ifndef MODEM_H__
#define MODEM_H__

/* modem.h - Copyright Svep Design Center AB */


/**** Includes ****/
#include <stdint.h>

/**** Defines ****/


/**** Types ****/
typedef enum {
    MODEM_EVENT_DISCONNECTED,
    MODEM_EVENT_CONNECTING,
    MODEM_EVENT_CONNECTED,
    MODEM_EVENT_PUBLISHED,
} modem_event_t;

typedef void (*modem_event_cb_t)(modem_event_t event, uint32_t payload);


/**** Data ****/


/**** Public functions ****/
int modem_init(modem_event_cb_t cb);
int modem_connect(void);

#endif
```
