## lib/nabto-embedded-sdk/Kconfig
```kconfig
config NABTO_EMBEDDED_SDK
	bool "nabto embedded sdk Support"
	help
	  This option enables the nabto embedded sdk library

module = NABTO
module-str = Nabto
source "subsys/logging/Kconfig.template.log_config"
```

## west.yml
```yaml
# Copyright (c) 2021 Nordic Semiconductor ASA
# SPDX-License-Identifier: Apache-2.0

manifest:
  self:
    west-commands: scripts/west-commands.yml

  remotes:
    - name: zephyrproject-rtos
      url-base: https://github.com/zephyrproject-rtos
    - name: nabto
      url-base: https://github.com/nabto

  projects:
    - name: zephyr
      remote: zephyrproject-rtos
      revision: v3.5.0
      import: true


    - name: nabto-embedded-sdk
      remote: nabto
      revision: b1f2c9d8f55e6f956fef4be4885ac3f4056d3515
      submodules: true
      path: modules/lib/nabto-embedded-sdk
```
