## prj.conf
```kconfig
CONFIG_NETWORKING=y
CONFIG_NET_UDP=y
CONFIG_NET_IPV4=y
CONFIG_NET_IPV6=y
CONFIG_NET_ARP=y
CONFIG_NET_DHCPV4=y
CONFIG_NET_STATISTICS=y
CONFIG_NET_SOCKETS=y
CONFIG_NET_SOCKETS_POSIX_NAMES=n
CONFIG_NET_SOCKETPAIR=y
CONFIG_NET_SOCKETS_POLL_MAX=42
CONFIG_NET_IPV4_IGMP=y
CONFIG_DNS_RESOLVER=y

CONFIG_INIT_STACKS=y

CONFIG_NET_MGMT=y
CONFIG_NET_MGMT_EVENT=y

CONFIG_NET_LOG=y
CONFIG_LOG=y

CONFIG_SHELL=y
CONFIG_NET_SHELL=y

CONFIG_NET_L2_ETHERNET=y

CONFIG_ENTROPY_GENERATOR=y
CONFIG_MBEDTLS_ZEPHYR_ENTROPY=y
#CONFIG_ENTROPY_DEVICE_RANDOM_GENERATOR=y

CONFIG_NABTO_EMBEDDED_SDK=y

CONFIG_MBEDTLS=y
CONFIG_MBEDTLS_PK_WRITE_C=y
CONFIG_MBEDTLS_PEM_CERTIFICATE_FORMAT=y
CONFIG_MBEDTLS_ECDSA_C=y
CONFIG_MBEDTLS_ECP_C=y
CONFIG_MBEDTLS_SSL_ALPN=y
CONFIG_MBEDTLS_ZEPHYR_ENTROPY=y
CONFIG_MBEDTLS_KEY_EXCHANGE_ECDHE_ECDSA_ENABLED=y
CONFIG_MBEDTLS_SERVER_NAME_INDICATION=y
CONFIG_MBEDTLS_DTLS=y
CONFIG_MBEDTLS_ECP_DP_SECP256R1_ENABLED=y

CONFIG_MBEDTLS_CIPHER_CCM_ENABLED=y
CONFIG_MBEDTLS_CIPHER_GCM_ENABLED=y

CONFIG_MBEDTLS_USER_CONFIG_ENABLE=y
CONFIG_MBEDTLS_USER_CONFIG_FILE="user_tls_config.h"

CONFIG_NEWLIB_LIBC=y
CONFIG_CBPRINTF_FP_SUPPORT=y

CONFIG_MAIN_STACK_SIZE=8192
CONFIG_SYSTEM_WORKQUEUE_STACK_SIZE=8192
CONFIG_ISR_STACK_SIZE=8192
CONFIG_HEAP_MEM_POOL_SIZE=65536

CONFIG_ETH_STM32_HAL_RX_THREAD_STACK_SIZE=3000


CONFIG_THREAD_STACK_INFO=y
CONFIG_THREAD_MONITOR=y
CONFIG_KERNEL_SHELL=y
CONFIG_INIT_STACKS=y
CONFIG_THREAD_NAME=y
CONFIG_STACK_SENTINEL=y
CONFIG_DEBUG_THREAD_INFO=y
CONFIG_LOG_MODE_IMMEDIATE=y
```

## src/main.c
```c
#include <zephyr/net/net_if.h>

#include <nabto/nabto_device_test.h>

#include <stdio.h>
LOG_MODULE_REGISTER(main);

void nabto_log_output(NabtoDeviceLogMessage* msg, void* data)
{
    LOG_INF("%s", msg->message);
    return;
    if (msg->severity == NABTO_DEVICE_LOG_ERROR) {
        LOG_ERR("%s", msg->message);
    } else if (msg->severity == NABTO_DEVICE_LOG_INFO) {
        LOG_INF("%s", msg->message);
    } else if (msg->severity == NABTO_DEVICE_LOG_WARN) {
        LOG_WRN("%s", msg->message);
    } else if (msg->severity == NABTO_DEVICE_LOG_TRACE) {
        LOG_DBG("%s", msg->message);
    }
}

void main(void) {
    LOG_INF("Started");
    return;

    struct net_if *iface;
    iface = net_if_get_default();
    net_dhcpv4_start(iface);

    // wait for dhcp
    k_sleep(K_MSEC(4000));

    //return;

    nabto_device_set_log_callback(NULL, nabto_log_output, NULL);
    if (nabto_device_set_log_level(NULL, "trace") != NABTO_DEVICE_EC_OK) {
        LOG_INF("Failed to set loglevel");
    }

    NabtoDevice* device = nabto_device_test_new();
    if (device == NULL) {
        LOG_ERR("device == NULL");
    } else {
        NabtoDeviceFuture* future = nabto_device_future_new(device);
        nabto_device_test_dns(device, future);
        NabtoDeviceError ec = nabto_device_future_wait(future);
        if (ec == NABTO_DEVICE_EC_OK) {
            LOG_INF("dns test passed");
        } else {
            LOG_INF("dns test failed");
        }

        nabto_device_test_future_resolve(device, future);
        ec = nabto_device_future_wait(future);
        if (ec == NABTO_DEVICE_EC_OK) {
            LOG_INF("future resolve test passed");
        } else {
            LOG_INF("future resolve test failed");
        }

        nabto_device_test_event_queue(device, future);
        ec = nabto_device_future_wait(future);
        if (ec == NABTO_DEVICE_EC_OK) {
            LOG_INF("event queue test passed");
        } else {
            LOG_INF("event queue test failed");
        }

        nabto_device_test_logging(device);

        uint32_t ts1;
        uint32_t ts2;
        nabto_device_test_timestamp(device, &ts1);
        k_sleep(K_MSEC(1000));
        nabto_device_test_timestamp(device, &ts2);
        LOG_INF("Timestamp difference should be ~1000, %d", ts2 - ts1);

        nabto_device_test_udp(device, "192.168.1.163", 1235, future);
        ec = nabto_device_future_wait(future);
        if (ec == NABTO_DEVICE_EC_OK) {
            LOG_INF("udp test passed");
        } else {
            LOG_INF("udp test failed");
        }

        nabto_device_test_mdns_publish_service(device);

        k_sleep(K_FOREVER);

        nabto_device_future_free(future);
        nabto_device_test_free(device);
    }
    LOG_INF("test end");
}
```
