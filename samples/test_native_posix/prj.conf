## prj.conf
```kconfig
CONFIG_NETWORKING=y
CONFIG_NET_UDP=y
CONFIG_NET_TCP=y
CONFIG_NET_IPV4=y
CONFIG_NET_IPV6=y
CONFIG_NET_ARP=y
CONFIG_NET_DHCPV4=y
CONFIG_NET_STATISTICS=y
CONFIG_NET_SOCKETS=y
CONFIG_NET_SOCKETS_POSIX_NAMES=n
CONFIG_NET_SOCKETPAIR=y
CONFIG_NET_SOCKETS_POLL_MAX=42
CONFIG_NET_IPV4_IGMP=y
CONFIG_NET_L2_ETHERNET=y

CONFIG_NET_CONFIG_SETTINGS=y
CONFIG_NET_CONFIG_NEED_IPV6=y
CONFIG_NET_CONFIG_NEED_IPV4=y
CONFIG_NET_CONFIG_MY_IPV6_ADDR="2001:db8::1"
CONFIG_NET_CONFIG_PEER_IPV6_ADDR="2001:db8::2"
CONFIG_NET_CONFIG_MY_IPV4_ADDR="192.0.2.1"
CONFIG_NET_CONFIG_PEER_IPV4_ADDR="192.0.2.2"
CONFIG_NET_CONFIG_MY_IPV4_GW="192.0.2.2"

CONFIG_DNS_RESOLVER=y
CONFIG_DNS_RESOLVER_MAX_SERVERS=2
CONFIG_DNS_NUM_CONCUR_QUERIES=1
CONFIG_DNS_SERVER_IP_ADDRESSES=y
CONFIG_DNS_SERVER1="8.8.8.8"
CONFIG_DNS_SERVER2="2001:db8::2"

CONFIG_ETH_NATIVE_POSIX=y
CONFIG_ETH_NATIVE_POSIX_RANDOM_MAC=y
CONFIG_NABTO_EMBEDDED_SDK=y

CONFIG_MBEDTLS=y
CONFIG_MBEDTLS_USER_CONFIG_ENABLE=y
CONFIG_MBEDTLS_USER_CONFIG_FILE="user_tls_config.h"

CONFIG_ENTROPY_GENERATOR=y
CONFIG_MBEDTLS_ZEPHYR_ENTROPY=y


CONFIG_HEAP_MEM_POOL_SIZE=65536

CONFIG_SHELL=y
CONFIG_NET_SHELL=y
CONFIG_KERNEL_SHELL=y

CONFIG_LOG_MODE_IMMEDIATE=y
CONFIG_SHELL_LOG_BACKEND=y
```

## boards/native_posix.conf
```kconfig
CONFIG_NET_CONFIG_MY_IPV6_ADDR="2001:db8::1"
CONFIG_NET_CONFIG_PEER_IPV6_ADDR="2001:db8::2"
CONFIG_NET_CONFIG_MY_IPV4_ADDR="192.0.2.1"
CONFIG_NET_CONFIG_PEER_IPV4_ADDR="192.0.2.2"
CONFIG_NET_CONFIG_MY_IPV4_GW="192.0.2.2"

CONFIG_ETH_NATIVE_POSIX=y
CONFIG_ETH_NATIVE_POSIX_RANDOM_MAC=y
```

## boards/stm32f746g_disco.conf
```kconfig
CONFIG_ENTROPY_STM32_RNG=y

CONFIG_NET_DHCPV4=y
CONFIG_ETH_STM32_HAL_RX_THREAD_STACK_SIZE=3000
CONFIG_SHELL_STACK_SIZE=8192
```

## src/main.c
```c
#include <zephyr/net/net_if.h>

void main(void) {
    struct net_if *iface;
    iface = net_if_get_default();
    net_dhcpv4_start(iface);
}
```
