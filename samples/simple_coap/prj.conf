## CMakeLists.txt
```
cmake_minimum_required(VERSION 3.13.1)
find_package(Zephyr REQUIRED HINTS $ENV{ZEPHYR_BASE})

project(app LANGUAGES C VERSION 1.0.0)

target_sources(app PRIVATE src/main.c)
zephyr_include_directories(${APPLICATION_SOURCE_DIR}/src/tls_config)
```

## Kconfig
```
mainmenu "Nabto Edge Simple Coap Demo"

config SIMPLE_COAP_PRODUCT_ID
	string "nabto product id"
	default "pr-123"
	help
	  The nabto product id to use

config SIMPLE_COAP_DEVICE_ID
	string "nabto device id"
	default "de-123"
	help
	  The nabto device id to use

source "Kconfig.zephyr"
```

## prj.conf
```kconfig
CONFIG_NETWORKING=y
CONFIG_NET_UDP=y
CONFIG_NET_TCP=y
CONFIG_NET_IPV4=y
CONFIG_NET_IPV6=y
CONFIG_NET_ARP=y
CONFIG_NET_STATISTICS=y
CONFIG_NET_SOCKETS=y
CONFIG_NET_SOCKETS_POSIX_NAMES=n
CONFIG_NET_SOCKETPAIR=y
CONFIG_NET_SOCKETS_POLL_MAX=42
CONFIG_DNS_RESOLVER=y
CONFIG_NET_MAX_CONTEXTS=16
CONFIG_NET_MAX_CONN=16

CONFIG_POSIX_MAX_FDS=16

CONFIG_INIT_STACKS=y

CONFIG_NET_MGMT=y
CONFIG_NET_MGMT_EVENT=y

CONFIG_NET_LOG=y
CONFIG_LOG=y

CONFIG_SHELL=y
CONFIG_NET_SHELL=y

CONFIG_NET_L2_ETHERNET=y

CONFIG_ENTROPY_GENERATOR=y
CONFIG_MBEDTLS_ZEPHYR_ENTROPY=y

CONFIG_NABTO_EMBEDDED_SDK=y

CONFIG_MBEDTLS=y
CONFIG_MBEDTLS_BUILTIN=y
CONFIG_MBEDTLS_PK_WRITE_C=y
CONFIG_MBEDTLS_PEM_CERTIFICATE_FORMAT=y
CONFIG_MBEDTLS_ECDH_C=y
CONFIG_MBEDTLS_ECDSA_C=y
CONFIG_MBEDTLS_ECP_C=y
CONFIG_MBEDTLS_SSL_ALPN=y
CONFIG_MBEDTLS_KEY_EXCHANGE_ECDHE_ECDSA_ENABLED=y
CONFIG_MBEDTLS_SERVER_NAME_INDICATION=y
CONFIG_MBEDTLS_DTLS=y
CONFIG_MBEDTLS_ECP_DP_SECP256R1_ENABLED=y

CONFIG_MBEDTLS_CIPHER_CCM_ENABLED=y
CONFIG_MBEDTLS_CIPHER_GCM_ENABLED=y

CONFIG_MBEDTLS_USER_CONFIG_ENABLE=y
CONFIG_MBEDTLS_USER_CONFIG_FILE="user_tls_config.h"

CONFIG_ENTROPY_GENERATOR=y
CONFIG_MBEDTLS_ZEPHYR_ENTROPY=y

CONFIG_MAIN_STACK_SIZE=8192
CONFIG_SYSTEM_WORKQUEUE_STACK_SIZE=8192
CONFIG_ISR_STACK_SIZE=8192
CONFIG_HEAP_MEM_POOL_SIZE=65536
CONFIG_NET_RX_STACK_SIZE=8192
CONFIG_SHELL_STACK_SIZE=8192
CONFIG_NET_MGMT_EVENT_STACK_SIZE=8192
CONFIG_NET_TX_STACK_SIZE=8192
CONFIG_NET_TCP_WORKQ_STACK_SIZE=8192
CONFIG_IDLE_STACK_SIZE=8192

CONFIG_THREAD_STACK_INFO=y
CONFIG_THREAD_MONITOR=y
CONFIG_KERNEL_SHELL=y
CONFIG_INIT_STACKS=y
CONFIG_THREAD_NAME=y
#CONFIG_STACK_SENTINEL=y
CONFIG_DEBUG_THREAD_INFO=y
CONFIG_LOG_MODE_IMMEDIATE=y
CONFIG_ASSERT=y



CONFIG_FLASH=y
CONFIG_FLASH_PAGE_LAYOUT=y
CONFIG_FLASH_MAP=y

CONFIG_SETTINGS=y
CONFIG_SETTINGS_RUNTIME=y
CONFIG_SETTINGS_DYNAMIC_HANDLERS=y
CONFIG_SETTINGS_SHELL=y
CONFIG_MPU_ALLOW_FLASH_WRITE=y

CONFIG_REBOOT=y


## Local config
CONFIG_SIMPLE_COAP_PRODUCT_ID="pr-9fbbczma"
CONFIG_SIMPLE_COAP_DEVICE_ID="de-ncozrk3s"
CONFIG_SIMPLE_COAP_PRIVATE_KEY="1d8997f266bae21dc56be42cf669b932952d9576bbb12bbae2d34a2c0be60391"

CONFIG_NABTO_LOG_LEVEL_DBG=y
```

## boards/native_posix_64.conf
```kconfig
CONFIG_NET_CONFIG_SETTINGS=y
CONFIG_NET_CONFIG_MY_IPV6_ADDR="2001:db8::1"
CONFIG_NET_CONFIG_PEER_IPV6_ADDR="2001:db8::2"
CONFIG_NET_CONFIG_MY_IPV4_ADDR="192.0.2.1"
CONFIG_NET_CONFIG_PEER_IPV4_ADDR="192.0.2.2"
CONFIG_NET_CONFIG_MY_IPV4_GW="192.0.2.2"

CONFIG_DNS_RESOLVER=y
CONFIG_DNS_RESOLVER_MAX_SERVERS=2
CONFIG_DNS_NUM_CONCUR_QUERIES=1
CONFIG_DNS_SERVER_IP_ADDRESSES=y
CONFIG_DNS_SERVER1="8.8.8.8"
CONFIG_DNS_SERVER2="2001:db8::2"

CONFIG_ETH_NATIVE_POSIX=y
CONFIG_ETH_NATIVE_POSIX_RANDOM_MAC=y

CONFIG_FILE_SYSTEM=y
CONFIG_FILE_SYSTEM_LITTLEFS=y
CONFIG_SETTINGS_FS=y
CONFIG_SETTINGS_FS_DIR="/ff/settings"
CONFIG_SETTINGS_FS_FILE="/ff/settings/run"
```

## boards/native_sim.conf
```kconfig
CONFIG_NET_CONFIG_SETTINGS=y
CONFIG_NET_CONFIG_MY_IPV6_ADDR="2001:db8::1"
CONFIG_NET_CONFIG_PEER_IPV6_ADDR="2001:db8::2"
CONFIG_NET_CONFIG_MY_IPV4_ADDR="192.0.2.1"
CONFIG_NET_CONFIG_PEER_IPV4_ADDR="192.0.2.2"
CONFIG_NET_CONFIG_MY_IPV4_GW="192.0.2.2"

CONFIG_DNS_RESOLVER=y
CONFIG_DNS_RESOLVER_MAX_SERVERS=2
CONFIG_DNS_NUM_CONCUR_QUERIES=1
CONFIG_DNS_SERVER_IP_ADDRESSES=y
CONFIG_DNS_SERVER1="8.8.8.8"
CONFIG_DNS_SERVER2="2001:db8::2"

CONFIG_ETH_NATIVE_POSIX=y
CONFIG_ETH_NATIVE_POSIX_RANDOM_MAC=y
```

## boards/stm32f746g_disco.conf
```kconfig
CONFIG_ENTROPY_STM32_RNG=y

CONFIG_NET_DHCPV4=y
CONFIG_ETH_STM32_HAL_RX_THREAD_STACK_SIZE=3000
CONFIG_SHELL_STACK_SIZE=8192

CONFIG_NEWLIB_LIBC=y
CONFIG_CBPRINTF_FP_SUPPORT=y

CONFIG_FILE_SYSTEM=y
CONFIG_FILE_SYSTEM_SHELL=y
CONFIG_FILE_SYSTEM_LITTLEFS=y
CONFIG_SETTINGS_FS=y
CONFIG_SETTINGS_FS_DIR="/ff/settings"
CONFIG_SETTINGS_FS_FILE="/ff/settings/run"
```

## boards/native_posix_64.overlay
```dts
/delete-node/ &storage_partition;
/delete-node/ &scratch_partition;

&rng {
	status = "okay";
};
```

## boards/stm32f746g_disco.overlay
```dts
&rng {
	status = "okay";
};
```

## src/main.c
```c
#include <zephyr/net/net_if.h>
#include <zephyr/settings/settings.h>

#include <nabto/nabto_device_test.h>
#include <nabto/nabto_device_experimental.h>
#include <nabto/nabto_device_zephyr.h>

#if IS_ENABLED(CONFIG_SETTINGS_FS)
#include <zephyr/fs/fs.h>
#include <zephyr/fs/littlefs.h>
#endif

#include <stdio.h>

LOG_MODULE_REGISTER(main);

#define STORAGE_PARTITION	storage_partition
#define STORAGE_PARTITION_ID	FIXED_PARTITION_ID(STORAGE_PARTITION)


static const char* coapPath[] = { "hello-world", NULL };
static const char* helloWorld = "Hello World from zephyr";

#define ASSERT_NABTO_EC(ec) __ASSERT(ec == NABTO_DEVICE_EC_OK, "Call failed %s", nabto_device_error_get_message(ec))

static void init_fs()
{
#if IS_ENABLED(CONFIG_SETTINGS_FS)
    int rc;
    FS_LITTLEFS_DECLARE_DEFAULT_CONFIG(cstorage);

    /* mounting info */
    static struct fs_mount_t littlefs_mnt = {
        .type = FS_LITTLEFS,
        .fs_data = &cstorage,
        .storage_dev = (void *)STORAGE_PARTITION_ID,
        .mnt_point = "/ff"};

    rc = fs_mount(&littlefs_mnt);
    if (rc != 0)
    {
        printk("mounting littlefs error: [%d]\n", rc);
    }
    else
    {

        rc = fs_unlink(CONFIG_SETTINGS_FS_FILE);
        if ((rc != 0) && (rc != -ENOENT))
        {
            printk("can't delete config file%d\n", rc);
        }
        else
        {
            printk("FS initialized: OK\n");
        }
    }
#endif
}

int main(void)
{
    init_fs();
    int status;
    status = settings_subsys_init();
    if (status != 0) {
        LOG_ERR("Cannot init settings %s", strerror(-status));
        return 1;
    }
    status = settings_load();
    __ASSERT(status == 0, "cannot load settings");


    struct net_if *iface;
    iface = net_if_get_default();

#if CONFIG_NET_DHCPV4
    net_dhcpv4_start(iface);
#endif

    NabtoDeviceError ec;

    NabtoDevice* device = nabto_device_zephyr_get_default_instance();

    __ASSERT(device != NULL, "Device is NULL");

    ec = nabto_device_set_product_id(device, CONFIG_SIMPLE_COAP_PRODUCT_ID);
    ASSERT_NABTO_EC(ec);

    ec = nabto_device_set_device_id(device, CONFIG_SIMPLE_COAP_DEVICE_ID);
    ASSERT_NABTO_EC(ec);

    uint8_t key[32];
    __ASSERT(strlen(CONFIG_SIMPLE_COAP_PRIVATE_KEY) == 64, "CONFIG_SIMPLE_COAP_PRIVATE_KEY should be 64 hex characters");
    size_t convertedLength = hex2bin(CONFIG_SIMPLE_COAP_PRIVATE_KEY, strlen(CONFIG_SIMPLE_COAP_PRIVATE_KEY), key, sizeof(key));
    __ASSERT(convertedLength == sizeof(key), "Could not parse the hex string CONFIG_SIMPLE_COAP_PRIVATE_KEY");
    ec = nabto_device_set_private_key_secp256r1(device, key, sizeof(key));

#if defined(NET_ROUTE_MCAST)
    ec = nabto_device_enable_mdns(device);
    ASSERT_NABTO_EC(ec);
#endif

    ec = nabto_device_add_server_connect_token(device, "demosct");
    ASSERT_NABTO_EC(ec);

    NabtoDeviceFuture* future = nabto_device_future_new(device);
    __ASSERT(future != NULL, "Future is null");

    nabto_device_start(device, future);
    ec = nabto_device_future_wait(future);
    ASSERT_NABTO_EC(ec);

    char* fp = NULL;
    ec = nabto_device_get_device_fingerprint(device, &fp);
    ASSERT_NABTO_EC(ec);

    LOG_INF("Nabto Device has been started with fingerprint %s", fp);
    nabto_device_string_free(fp);

    NabtoDeviceListener* listener = nabto_device_listener_new(device);
    __ASSERT(listener != NULL, "Listener is NULL");

    ec = nabto_device_coap_init_listener(device, listener, NABTO_DEVICE_COAP_GET, coapPath);
    ASSERT_NABTO_EC(ec);

    while(true)
    {
        NabtoDeviceCoapRequest* coapRequest;
        nabto_device_listener_new_coap_request(listener, future, &coapRequest);

        ec = nabto_device_future_wait(future);
        if (ec != NABTO_DEVICE_EC_OK) {
            break;
        } else
        {
            nabto_device_coap_response_set_code(coapRequest, 205);
            nabto_device_coap_response_set_content_format(coapRequest, NABTO_DEVICE_COAP_CONTENT_FORMAT_TEXT_PLAIN_UTF8);

            if (nabto_device_coap_response_set_payload(coapRequest, helloWorld, strlen(helloWorld)) == NABTO_DEVICE_EC_OK)
            {
                nabto_device_coap_response_ready(coapRequest);
            }
            LOG_INF("Responded to CoAP request\n");
            nabto_device_coap_request_free(coapRequest);
        }
    }

    nabto_device_listener_free(listener);
    nabto_device_future_free(future);
    return 0;
}
```
