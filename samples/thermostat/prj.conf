## CMakeLists.txt
```
cmake_minimum_required(VERSION 3.13.1)
find_package(Zephyr REQUIRED HINTS $ENV{ZEPHYR_BASE})

project(app LANGUAGES C VERSION 1.0.0)

set(NABTO_DIR ${CMAKE_CURRENT_LIST_DIR}/../../../modules/lib/nabto-embedded-sdk)
set(THERMOSTAT_DIR ${NABTO_DIR}/examples/thermostat)

zephyr_compile_options("-DHAVE_OPEN")

set(src
    src/main.c
    ${THERMOSTAT_DIR}/src/thermostat.c
    ${THERMOSTAT_DIR}/src/thermostat_coap_handler.c
    ${THERMOSTAT_DIR}/src/thermostat_state.c
    ${THERMOSTAT_DIR}/src/thermostat_state_data.c
    ${THERMOSTAT_DIR}/src/thermostat_state_file_backend.c
    ${THERMOSTAT_DIR}/src/thermostat_iam.c
    ${THERMOSTAT_DIR}/src/thermostat_get.c
    ${THERMOSTAT_DIR}/src/thermostat_set_mode.c
    ${THERMOSTAT_DIR}/src/thermostat_set_power.c
    ${THERMOSTAT_DIR}/src/thermostat_set_target.c
    ${ne_iam_src}

    ${NABTO_DIR}/apps/common/json_config.c
    ${NABTO_DIR}/apps/common/random_string.c
    ${NABTO_DIR}/apps/common/string_file.c

)

target_sources(app PRIVATE ${src})
zephyr_include_directories(${APPLICATION_SOURCE_DIR}/src/tls_config ${NABTO_DIR}/3rdparty/tinycbor/tinycbor/src ${NABTO_DIR}/src ${NABTO_DIR}/nabto-common/components/nn/include ${NABTO_DIR}/3rdparty/tinycbor/extra ${NABTO_DIR} ${NABTO_DIR}/3rdparty/cjson ${NABTO_DIR}/examples/thermostat/src)
```

## Kconfig
```
mainmenu "Nabto Edge Thermostat Demo"

config THERMOSTAT_PRODUCT_ID
	string "nabto product id"
	default "pr-123"
	help
	  The nabto product id to use

config THERMOSTAT_DEVICE_ID
	string "nabto device id"
	default "de-123"
	help
	  The nabto device id to use

config THERMOSTAT_PRIVATE_KEY
    string "nabto device key"
	default ""
	help
	  The nabto device key as a hex encoded 256bit random number

source "Kconfig.zephyr"
```

## prj.conf
```kconfig
CONFIG_NETWORKING=y
CONFIG_NET_UDP=y
CONFIG_NET_TCP=y
CONFIG_NET_IPV4=y
CONFIG_NET_IPV6=y
CONFIG_NET_ARP=y
CONFIG_NET_STATISTICS=y
CONFIG_NET_SOCKETS=y
CONFIG_NET_SOCKETS_POSIX_NAMES=n
CONFIG_NET_SOCKETPAIR=y
CONFIG_NET_SOCKETS_POLL_MAX=42
CONFIG_DNS_RESOLVER=y
CONFIG_NET_MAX_CONTEXTS=16
CONFIG_NET_MAX_CONN=16

CONFIG_POSIX_MAX_FDS=16

CONFIG_INIT_STACKS=y

CONFIG_NET_MGMT=y
CONFIG_NET_MGMT_EVENT=y

CONFIG_NET_LOG=y
CONFIG_LOG=y

CONFIG_SHELL=y
CONFIG_NET_SHELL=y

CONFIG_NET_L2_ETHERNET=y

CONFIG_ENTROPY_GENERATOR=y
CONFIG_MBEDTLS_ZEPHYR_ENTROPY=y

CONFIG_NABTO_EMBEDDED_SDK=y

CONFIG_MBEDTLS=y
CONFIG_MBEDTLS_PK_WRITE_C=y
CONFIG_MBEDTLS_PEM_CERTIFICATE_FORMAT=y
CONFIG_MBEDTLS_ECDSA_C=y
CONFIG_MBEDTLS_ECP_C=y
CONFIG_MBEDTLS_SSL_ALPN=y
CONFIG_MBEDTLS_KEY_EXCHANGE_ECDHE_ECDSA_ENABLED=y
CONFIG_MBEDTLS_SERVER_NAME_INDICATION=y
CONFIG_MBEDTLS_DTLS=y
CONFIG_MBEDTLS_ECP_DP_SECP256R1_ENABLED=y

CONFIG_MBEDTLS_CIPHER_CCM_ENABLED=y
CONFIG_MBEDTLS_CIPHER_GCM_ENABLED=y

CONFIG_MBEDTLS_USER_CONFIG_ENABLE=y
CONFIG_MBEDTLS_USER_CONFIG_FILE="user_tls_config.h"

CONFIG_ENTROPY_GENERATOR=y
CONFIG_MBEDTLS_ZEPHYR_ENTROPY=y

CONFIG_MAIN_STACK_SIZE=8192
CONFIG_SYSTEM_WORKQUEUE_STACK_SIZE=8192
CONFIG_ISR_STACK_SIZE=8192
CONFIG_HEAP_MEM_POOL_SIZE=65536
CONFIG_NET_RX_STACK_SIZE=8192
CONFIG_SHELL_STACK_SIZE=8192
CONFIG_NET_MGMT_EVENT_STACK_SIZE=8192
CONFIG_NET_TX_STACK_SIZE=8192
CONFIG_NET_TCP_WORKQ_STACK_SIZE=8192
CONFIG_IDLE_STACK_SIZE=8192

CONFIG_THREAD_STACK_INFO=y
CONFIG_THREAD_MONITOR=y
CONFIG_KERNEL_SHELL=y
CONFIG_INIT_STACKS=y
CONFIG_THREAD_NAME=y
#CONFIG_STACK_SENTINEL=y
CONFIG_DEBUG_THREAD_INFO=y
CONFIG_LOG_MODE_IMMEDIATE=y
CONFIG_ASSERT=y



CONFIG_FLASH=y
CONFIG_FLASH_PAGE_LAYOUT=y
CONFIG_FLASH_MAP=y

CONFIG_SETTINGS=y
CONFIG_SETTINGS_RUNTIME=y
CONFIG_SETTINGS_DYNAMIC_HANDLERS=y
CONFIG_SETTINGS_SHELL=y
CONFIG_MPU_ALLOW_FLASH_WRITE=y

CONFIG_REBOOT=y

CONFIG_SETTINGS_FS=y
CONFIG_FILE_SYSTEM_SHELL=y
CONFIG_POSIX_FS=y
CONFIG_POSIX_MAX_OPEN_FILES=16


## Local config
CONFIG_THERMOSTAT_PRODUCT_ID="pr-9fbbczma"
CONFIG_THERMOSTAT_DEVICE_ID="de-ncozrk3s"
CONFIG_THERMOSTAT_PRIVATE_KEY="1d8997f266bae21dc56be42cf669b932952d9576bbb12bbae2d34a2c0be60391"
```

## src/main.c
```c
#include <zephyr/net/net_if.h>
#include <zephyr/settings/settings.h>

#include <nabto/nabto_device_test.h>
#include <nabto/nabto_device_experimental.h>
#include <nabto/nabto_device_zephyr.h>

#include <nn/log.h>

#include "thermostat_iam.h"
#include "thermostat_state.h"
#include "thermostat_state_file_backend.h"

#if IS_ENABLED(CONFIG_SETTINGS_FS)
#include <zephyr/fs/fs.h>
#include <zephyr/fs/littlefs.h>
#endif

#include <stdio.h>

LOG_MODULE_REGISTER(main);

#define STORAGE_PARTITION	storage_partition
#define STORAGE_PARTITION_ID	FIXED_PARTITION_ID(STORAGE_PARTITION)

#define ASSERT_NABTO_EC(ec) __ASSERT(ec == NABTO_DEVICE_EC_OK, "Call failed %s", nabto_device_error_get_message(ec))

static void init_fs()
{
#if IS_ENABLED(CONFIG_SETTINGS_FS)
    int rc;
    FS_LITTLEFS_DECLARE_DEFAULT_CONFIG(cstorage);

    /* mounting info */
    static struct fs_mount_t littlefs_mnt = {
        .type = FS_LITTLEFS,
        .fs_data = &cstorage,
        .storage_dev = (void *)STORAGE_PARTITION_ID,
        .mnt_point = "/ff"};

    rc = fs_mount(&littlefs_mnt);
    if (rc != 0)
    {
        printk("mounting littlefs error: [%d]\n", rc);
    }
    else
    {

        rc = fs_unlink(CONFIG_SETTINGS_FS_FILE);
        if ((rc != 0) && (rc != -ENOENT))
        {
            printk("can't delete config file%d\n", rc);
        }
        else
        {
            printk("FS initialized: OK\n");
        }
    }
#endif
}

void create_directories()
{
    int ec;
    ec = fs_mkdir("/ff/nabto");
    __ASSERT(ec == 0 || ec == -EEXIST, "%s", strerror(-ec));
    ec = fs_mkdir("/ff/nabto/state");
    __ASSERT(ec == 0 || ec == -EEXIST, "%s", strerror(-ec));
}

static const char* iamStateFile = "/ff/nabto/state/thermostat_iam_state.json";
static const char* thermostatStateFile = "/ff/nabto/state/thermostat_state.json";

void main(void)
{
    init_fs();

    create_directories();

    struct net_if *iface;
    iface = net_if_get_default();

#if CONFIG_NET_DHCPV4
    net_dhcpv4_start(iface);
#endif

    NabtoDeviceError ec;

    NabtoDevice* device = nabto_device_zephyr_get_default_instance();

    __ASSERT(device != NULL, "Device is NULL");

    ec = nabto_device_set_product_id(device, CONFIG_THERMOSTAT_PRODUCT_ID);
    ASSERT_NABTO_EC(ec);

    ec = nabto_device_set_device_id(device, CONFIG_THERMOSTAT_DEVICE_ID);
    ASSERT_NABTO_EC(ec);

    uint8_t key[32];
    __ASSERT(strlen(CONFIG_THERMOSTAT_PRIVATE_KEY) == 64, "CONFIG_SIMPLE_COAP_PRIVATE_KEY should be 64 hex characters");
    size_t convertedLength = hex2bin(CONFIG_THERMOSTAT_PRIVATE_KEY, strlen(CONFIG_THERMOSTAT_PRIVATE_KEY), key, sizeof(key));
    __ASSERT(convertedLength == sizeof(key), "Could not parse the hex string CONFIG_THERMOSTAT_PRIVATE_KEY");
    ec = nabto_device_set_private_key_secp256r1(device, key, sizeof(key));

    ec = nabto_device_enable_mdns(device);
    ASSERT_NABTO_EC(ec);

    ec = nabto_device_mdns_add_subtype(device, "thermostat");

    ec = nabto_device_add_server_connect_token(device, "demosct");
    ASSERT_NABTO_EC(ec);

    NabtoDeviceFuture* future = nabto_device_future_new(device);
    __ASSERT(future != NULL, "Future is null");

    nabto_device_start(device, future);
    ec = nabto_device_future_wait(future);
    ASSERT_NABTO_EC(ec);

    char* fp = NULL;
    ec = nabto_device_get_device_fingerprint(device, &fp);
    ASSERT_NABTO_EC(ec);

    LOG_INF("Nabto Device has been started with fingerprint %s", fp);
    nabto_device_string_free(fp);

    struct nm_file fileImpl = nm_file_zephyr_get_impl();

    struct thermostat_iam thermostatIam;
    thermostat_iam_init(&thermostatIam, device, &fileImpl, iamStateFile, NULL);
    bool s = thermostat_iam_load_state(&thermostatIam);
    //__ASSERT(s, "Could not load iam state");

    struct thermostat_state state;
    struct thermostat_state_file_backend thermostatStateFileBackend;
    thermostat_state_file_backend_init(&thermostatStateFileBackend, &state, &fileImpl, thermostatStateFile);

    struct thermostat t;
    thermostat_init(&t, device, &thermostatIam.iam, &state, NULL);
    //thermostate_state_file_backend_load_data(&thermostatStateFileBackend, NULL);

    while (true) {
        k_sleep(K_SECONDS(1));
    }

}
```
